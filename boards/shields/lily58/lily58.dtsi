/*
 * Lily58 base DTSI
 * Defines common hardware for both halves.
 *
 * SPDX-License-Identifier: MIT
 */

#include <dt-bindings/zmk/matrix-transform.h>

/ {
	compatible = "lily58";
	model = "Lily58";
};

&kscan0 {
	compatible = "zmk,kscan-gpio-matrix";
	diode-direction = "col2row";

	row-gpios =
			<&pro_micro 4 GPIO_ACTIVE_HIGH>,
			<&pro_micro 5 GPIO_ACTIVE_HIGH>,
			<&pro_micro 6 GPIO_ACTIVE_HIGH>,
			<&pro_micro 7 GPIO_ACTIVE_HIGH>;

	/* cols are set per-half in left/right overlays */
};

/* Logical layout for the keymap layer bindings */
&default_transform {
	col-offset = <0>;
	// For Lily58, the layout is 6 columns x 4 rows + thumb keys
	transform = <
						/* Row 0 */ MATRIX_KEY(0, 0) MATRIX_KEY(0, 1) MATRIX_KEY(0, 2) MATRIX_KEY(0, 3) MATRIX_KEY(0, 4)
									MATRIX_KEY(0, 5)
						/* Row 1 */ MATRIX_KEY(1, 0) MATRIX_KEY(1, 1) MATRIX_KEY(1, 2) MATRIX_KEY(1, 3) MATRIX_KEY(1, 4)
									MATRIX_KEY(1, 5)
						/* Row 2 */ MATRIX_KEY(2, 0) MATRIX_KEY(2, 1) MATRIX_KEY(2, 2) MATRIX_KEY(2, 3) MATRIX_KEY(2, 4)
									MATRIX_KEY(2, 5)
						/* Row 3 */ MATRIX_KEY(3, 0) MATRIX_KEY(3, 1) MATRIX_KEY(3, 2) MATRIX_KEY(3, 3) MATRIX_KEY(3, 4)
									MATRIX_KEY(3, 5)
				>;
};
