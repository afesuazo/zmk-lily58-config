/ {
	chosen {
		zmk,underglow = &underglow_leds;
	};
};

/* Bit-banged WS2812-compatible driver (works for SK6812) */
&gpio0 {
	ws2812: ws2812 {
		compatible = "worldsemi,ws2812-gpio";
		label = "WS2812";
		chain-length = <20>;                 /* <-- set to your LED count */
		/* Most SK6812 RGBW are GRBW; change order if colors are off. */
		color-mapping = <
								LED_COLOR_ID_GREEN
								LED_COLOR_ID_RED
								LED_COLOR_ID_BLUE
								LED_COLOR_ID_WHITE
						>;
		gpios = <&gpio0 6 GPIO_ACTIVE_HIGH>; /* data pin P0.06 */
		status = "okay";
	};
};

underglow_leds: underglow {
	compatible = "zmk,underglow";
	label = "UNDERGLOW";
	led-strip = <&ws2812>;
	status = "okay";
};
